## boards/shields/adafruit_2in_tft_ips_display/Kconfig.shield
```kconfig
# SPDX-License-Identifier: Apache-2.0
# SPDX-FileCopyrightText: Copyright 2025 Sam Blenny

config SHIELD_ADAFRUIT_2In_TFT_IPS_DISPLAY
	def_bool $(shields_list_contains,adafruit_2in_tft_ips_display)
```

## boards/shields/eyespi_mipi/Kconfig.shield
```kconfig
# SPDX-License-Identifier: Apache-2.0
# SPDX-FileCopyrightText: Copyright 2025 Sam Blenny

config SHIELD_EYESPI_MIPI
	def_bool $(shields_list_contains,eysepi_mipi)
```
