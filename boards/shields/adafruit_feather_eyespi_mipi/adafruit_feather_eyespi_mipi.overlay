/*
 * SPDX-License-Identifier: Apache-2.0
 * SPDX-FileCopyrightText: Copyright 2025 Sam Blenny
 *
 *
 * This maps from Feather header to EYESPI MIPI (spi + CS, DC, and RST).
 * To use this, build with a feather board, this shield, and an EYESPI MIPI
 * display shield.
 *
 * The pin mapping here is for a minimal SPI MIPI display configuration without
 * support for the microSD slot, I2C touch input, etc.
 *
 * For hardware, there isn't actually a PCB that goes from Feather to EYESPI.
 * This mapping is for connecting a Feather board to an Adafruit EYESPI
 * Breakout (P/N 5613) with a breadboard and hookup wire, using a subset of
 * the pinout in the EYESPI Breakout's Learn Guide.
 *
 * The boilerplate #gpio-cells, gpio-map-mask, gpio-map-pass-thru sequence
 * is necessary because Zephyr encodes pin mode information in the pin
 * specifiers. For more detail, read these docs:
 * - https://docs.zephyrproject.org/latest/hardware/porting/shields.html#gpio-nexus-nodes
 * - https://github.com/devicetree-org/devicetree-specification/blob/v0.4/source/chapter2-devicetree-basics.rst#nexus-nodes-and-specifier-mapping
 *
 * For EYESPI pinout docs, check out the EYESPI Breakout Learn Guide:
 * - https://learn.adafruit.com/adafruit-eyespi-breakout-board
 */


/ {
	adafruit_eyespi_mipi: connector {
		compatible = "adafruit-eyespi-mipi";
		#gpio-cells = <2>;
		gpio-map-mask = <0xffffffff 0xffffffc0>;
		gpio-map-pass-thru = <0 0x3f>;
		gpio-map =
			/*  0 0 */                        /* Vin   */
			/*  1 0 */                        /* Lite  */
			/*  2 0 */                        /* Gnd   */
			<   3 0   &feather_header  6 0>,  /* SCK   = feather SCK  */
			<   4 0   &feather_header  7 0>,  /* MOSI  = feather MOSI */
			<   5 0   &feather_header  8 0>,  /* MISO  = feather MISO */
			<   6 0   &feather_header 15 0>,  /* DC    = feather D6   */
			<   7 0   &feather_header 16 0>,  /* RST   = feather D9   */
			<   8 0   &feather_header 14 0>;  /* TCS   = feather D5   */
			/*  9 0 */                        /* SDCS  */
			/* 10 0 */                        /* MEMCS */
			/* 11 0 */                        /* TSCS  */
			/* 12 0 */                        /* SCL   */
			/* 13 0 */                        /* SDA   */
			/* 14 0 */                        /* INT   */
			/* 15 0 */                        /* BUSY  */
			/* 16 0 */                        /* GP1   */
			/* 17 0 */                        /* GP2   */
	};
};

eyespi_spi: &feather_spi {};
